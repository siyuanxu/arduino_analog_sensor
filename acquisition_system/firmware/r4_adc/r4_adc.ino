/*
 * Acquisition protocol v2 firmware for Arduino UNO R4 Minima / UNO R4 WiFi.
 * A0/A1 are sampled as a sequential pair every 200 ms and filtered with a
 * five-point trimmed mean. A2-A5 are read directly at each 500 ms frame.
 * No voltage or engineering-unit conversion is performed on the board.
 */

#include <Arduino.h>

#include "r4_adc_protocol.h"

#if !defined(ARDUINO_UNOR4_MINIMA) && !defined(ARDUINO_UNOR4_WIFI)
#error "Select Arduino UNO R4 Minima or UNO R4 WiFi; this sketch is not for Mega."
#endif

#if defined(ARDUINO_UNOR4_MINIMA) && defined(ARDUINO_UNOR4_WIFI)
#error "Conflicting UNO R4 board macros. Select exactly one supported board."
#endif

namespace {

constexpr uint32_t kSerialBaud = 115200;
constexpr uint8_t kMaxCommandBytesPerLoop = 32;
constexpr size_t kInfoBufferSize = 224;
constexpr size_t kFrameBufferSize = 192;
constexpr size_t kMinimaTxFifoSize = 256;  // Official core 1.6.0 TinyUSB FIFO.
static_assert(kInfoBufferSize <= kMinimaTxFifoSize,
              "INFO line storage must fit the Minima TX FIFO");
static_assert(kFrameBufferSize <= kMinimaTxFifoSize,
              "Data frame storage must fit the Minima TX FIFO");
static_assert(sizeof(r4adc::kHeaderLine) - 1 <= kMinimaTxFifoSize,
              "HEADER line must fit the Minima TX FIFO");

#if defined(ARDUINO_UNOR4_MINIMA)
constexpr char kBoardModel[] = "UNO_R4_MINIMA";
#else
constexpr char kBoardModel[] = "UNO_R4_WIFI";
#endif

constexpr uint8_t kAnalogPins[r4adc::kChannelCount] = {A0, A1, A2, A3, A4, A5};

enum PendingResponse : uint8_t {
  kPendingInfo = 1U << 0,
  kPendingHeader = 1U << 1,
  kPendingError = 1U << 2,
};

r4adc::MillisExtender uptime;
r4adc::SampleSchedule output_schedule;
r4adc::FilterSampleSchedule filter_schedule;
r4adc::TrimmedMeanWindow filter_windows[2];
r4adc::CommandParser command_parser;
uint8_t pending_responses = kPendingInfo | kPendingHeader;
bool serial_was_ready = false;
char info_line[kInfoBufferSize];

bool serialReady() {
#if defined(ARDUINO_UNOR4_WIFI)
  // On core 1.6.0 Serial is the UART link to the ESP32-S3 bridge and its bool
  // operator is always true; USB-host attachment cannot be detected here.
  return true;
#else
  return static_cast<bool>(Serial);
#endif
}

bool serialCanWriteWholeLine(size_t bytes) {
#if defined(ARDUINO_UNOR4_WIFI)
  // UART::availableForWrite() inherits the base implementation that returns
  // zero. Its write is blocking, so allow these bounded, low-rate lines.
  (void)bytes;
  return true;
#else
  // Every line generated by this firmware is shorter than the 256-byte FIFO.
  // Waiting is avoided: if the host is absent or the FIFO is busy, this
  // particular write is deferred (control) or skipped (sample data).
  if (bytes > kMinimaTxFifoSize) {
    return false;
  }
  return Serial.availableForWrite() >= static_cast<int>(bytes);
#endif
}

bool writeWholeLine(const char *line, size_t length) {
  if (!serialReady() || !serialCanWriteWholeLine(length)) {
    return false;
  }
  const size_t written = Serial.write(
      reinterpret_cast<const uint8_t *>(line), length);
  return written == length;
}

void processCommand(r4adc::Command command) {
  switch (command) {
    case r4adc::Command::kInfo:
      pending_responses |= kPendingInfo;
      break;
    case r4adc::Command::kHeader:
      pending_responses |= kPendingHeader;
      break;
    case r4adc::Command::kUnknown:
      pending_responses |= kPendingError;
      break;
    case r4adc::Command::kNone:
      break;
  }
}

void serviceCommandInput() {
  for (uint8_t count = 0;
       count < kMaxCommandBytesPerLoop && Serial.available() > 0; ++count) {
    const int input = Serial.read();
    if (input >= 0) {
      processCommand(command_parser.push(static_cast<char>(input)));
    }
  }
}

void serviceOnePendingResponse() {
  if (pending_responses & kPendingInfo) {
    const size_t length = strlen(info_line);
    if (writeWholeLine(info_line, length)) {
      pending_responses &= static_cast<uint8_t>(~kPendingInfo);
    }
    return;
  }
  if (pending_responses & kPendingHeader) {
    const size_t length = sizeof(r4adc::kHeaderLine) - 1;
    if (writeWholeLine(r4adc::kHeaderLine, length)) {
      pending_responses &= static_cast<uint8_t>(~kPendingHeader);
    }
    return;
  }
  if (pending_responses & kPendingError) {
    const size_t length = sizeof(r4adc::kUnknownCommandLine) - 1;
    if (writeWholeLine(r4adc::kUnknownCommandLine, length)) {
      pending_responses &= static_cast<uint8_t>(~kPendingError);
    }
  }
}

void acquireFilteredPair(bool reset_windows) {
  if (reset_windows) {
    filter_windows[0].reset();
    filter_windows[1].reset();
  }
  // The pair is sequential, not simultaneous. Both values are real ADC reads;
  // missed deadlines are never filled by copying an earlier value.
  filter_windows[0].add(static_cast<uint16_t>(analogRead(kAnalogPins[0])));
  filter_windows[1].add(static_cast<uint16_t>(analogRead(kAnalogPins[1])));
}

bool filtersReady() {
  return filter_windows[0].ready() && filter_windows[1].ready();
}

void acquireUnfilteredChannelsAndSend(uint64_t frame_time_ms) {
  uint16_t raw[r4adc::kChannelCount] = {
      filter_windows[0].latest(), filter_windows[1].latest(), 0, 0, 0, 0};
  for (uint8_t channel = 2; channel < r4adc::kChannelCount; ++channel) {
    // A2-A5 remain direct frame-time reads.
    raw[channel] = static_cast<uint16_t>(analogRead(kAnalogPins[channel]));
  }

  const uint16_t filtered[2] = {filter_windows[0].filtered(),
                                filter_windows[1].filtered()};
  uint16_t window0[r4adc::kFilterWindowSize];
  uint16_t window1[r4adc::kFilterWindowSize];
  filter_windows[0].copyOldestToNewest(window0);
  filter_windows[1].copyOldestToNewest(window1);

  char frame[kFrameBufferSize];
  const int length = r4adc::formatDataFrame(
      frame, sizeof(frame), frame_time_ms, raw, filtered, window0, window1);
  if (length <= 0 || static_cast<size_t>(length) >= sizeof(frame)) {
    return;
  }
  // Sampling has already happened even when native USB is absent or busy.
  writeWholeLine(frame, static_cast<size_t>(length));
}

}  // namespace

void setup() {
  // INPUT does not enable the internal pull-up. No channel is driven by this
  // sketch; the source must remain inside the board's actual analog range.
  for (uint8_t channel = 0; channel < r4adc::kChannelCount; ++channel) {
    pinMode(kAnalogPins[channel], INPUT);
  }
  analogReadResolution(r4adc::kAdcBits);
  Serial.begin(kSerialBaud);
  // Never wait for Serial/USB. Acquisition scheduling starts immediately.
  const uint32_t now = millis();
  uptime.extend(now);
  filter_schedule.begin(now);
  output_schedule.begin(now);

  const int info_length =
      r4adc::formatInfoLine(info_line, sizeof(info_line), kBoardModel);
  if (info_length <= 0 || static_cast<size_t>(info_length) >= sizeof(info_line)) {
    info_line[0] = '\0';
    pending_responses &= static_cast<uint8_t>(~kPendingInfo);
  }
}

void loop() {
  const uint32_t loop_start_ms = millis();
  uptime.extend(loop_start_ms);

  serviceCommandInput();

  const bool ready = serialReady();
  if (ready && !serial_was_ready) {
    // Also make reconnect self-describing; duplicate control lines are allowed.
    pending_responses |= kPendingInfo | kPendingHeader;
  }
  serial_was_ready = ready;
  serviceOnePendingResponse();

  // Refresh after any board-specific serial latency. A0/A1 acquisition is
  // serviced before frame output so the 1.000 s frame can contain the fifth
  // real 200 ms pair. A gap of at least 400 ms forces a clean re-warm.
  const uint32_t filter_now_ms = millis();
  const r4adc::FilterSampleAction filter_action =
      filter_schedule.poll(filter_now_ms);
  if (filter_action != r4adc::FilterSampleAction::kNotDue) {
    acquireFilteredPair(
        filter_action == r4adc::FilterSampleAction::kResetAndSample);
  }

  const uint32_t frame_start_ms = millis();
  const uint64_t extended_frame_start_ms = uptime.extend(frame_start_ms);
  if (output_schedule.due(frame_start_ms) && filtersReady()) {
    acquireUnfilteredChannelsAndSend(extended_frame_start_ms);
  }
}
